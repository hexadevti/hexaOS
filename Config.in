## Config.in
```kconfig
# hexaOS packages
source "$BR2_EXTERNAL_HEXAOS_PATH/package/hexa-wine/Config.in"
source "$BR2_EXTERNAL_HEXAOS_PATH/package/hexa-sof-bin/Config.in"
source "$BR2_EXTERNAL_HEXAOS_PATH/package/hexa-max98390/Config.in"
source "$BR2_EXTERNAL_HEXAOS_PATH/package/hexa-firefox/Config.in"
source "$BR2_EXTERNAL_HEXAOS_PATH/package/hexa-vscode/Config.in"
source "$BR2_EXTERNAL_HEXAOS_PATH/package/hexa-dxvk/Config.in"
source "$BR2_EXTERNAL_HEXAOS_PATH/package/hexa-taskmgr/Config.in"
source "$BR2_EXTERNAL_HEXAOS_PATH/package/hexa-settings/Config.in"
source "$BR2_EXTERNAL_HEXAOS_PATH/package/hexa-power/Config.in"
source "$BR2_EXTERNAL_HEXAOS_PATH/package/hexa-libfyaml/Config.in"
source "$BR2_EXTERNAL_HEXAOS_PATH/package/hexa-libostree/Config.in"
source "$BR2_EXTERNAL_HEXAOS_PATH/package/hexa-appstream/Config.in"
source "$BR2_EXTERNAL_HEXAOS_PATH/package/hexa-flatpak/Config.in"
source "$BR2_EXTERNAL_HEXAOS_PATH/package/hexa-files/Config.in"
source "$BR2_EXTERNAL_HEXAOS_PATH/package/hexa-store/Config.in"
source "$BR2_EXTERNAL_HEXAOS_PATH/package/hexa-alsa-ucm-conf/Config.in"
```

## package/hexa-alsa-ucm-conf/Config.in
```kconfig
config BR2_PACKAGE_HEXA_ALSA_UCM_CONF
	bool "hexa-alsa-ucm-conf (ALSA sound card profiles)"
	depends on BR2_PACKAGE_ALSA_LIB_UCM
	help
	  ALSA Use Case Manager profiles: they tell PipeWire which
	  devices of a sound card are the speakers, the headphone jack,
	  the headset microphone and the built-in (digital) microphones.
	  Without them, Intel SOF laptops show no internal microphone.
	  Installed into /usr/share/alsa/ucm2.

	  https://github.com/alsa-project/alsa-ucm-conf

comment "hexa-alsa-ucm-conf needs alsa-lib with UCM"
	depends on !BR2_PACKAGE_ALSA_LIB_UCM
```

## package/hexa-appstream/Config.in
```kconfig
config BR2_PACKAGE_HEXA_APPSTREAM
	bool "hexa-appstream"
	depends on BR2_USE_WCHAR # libglib2
	depends on BR2_TOOLCHAIN_HAS_THREADS # libglib2
	depends on BR2_USE_MMU # libglib2
	select BR2_PACKAGE_LIBGLIB2
	select BR2_PACKAGE_LIBCURL
	select BR2_PACKAGE_LIBXML2
	select BR2_PACKAGE_LIBXMLB
	select BR2_PACKAGE_ZSTD
	select BR2_PACKAGE_HEXA_LIBFYAML
	help
	  AppStream library: reads the app catalog metadata of software
	  stores. Needed by Flatpak. Only the library is built (no
	  appstreamcli tool, translations or docs).

	  https://www.freedesktop.org/wiki/Distributions/AppStream/
```

## package/hexa-dxvk/Config.in
```kconfig
config BR2_PACKAGE_HEXA_DXVK
	bool "hexa-dxvk"
	depends on BR2_PACKAGE_HEXA_WINE
	help
	  DXVK: Direct3D 8/9/10/11 on top of Vulkan, for games in Wine.
	  Install it into a Wine prefix with the "hexa-dxvk" command.

	  https://github.com/doitsujin/dxvk
```

## package/hexa-files/Config.in
```kconfig
config BR2_PACKAGE_HEXA_FILES
	bool "hexa-files"
	depends on BR2_PACKAGE_LIBGTK3
	help
	  The hexaOS file manager, laid out like Windows Explorer:
	  places and drives on the left, back/forward/up, an address
	  bar, search, large icons or a details list, copy/cut/paste,
	  rename, Trash, properties and "open with".
```

## package/hexa-firefox/Config.in
```kconfig
config BR2_PACKAGE_HEXA_FIREFOX
	bool "hexa-firefox"
	depends on BR2_x86_64
	depends on BR2_TOOLCHAIN_USES_GLIBC
	depends on BR2_PACKAGE_XORG7
	select BR2_PACKAGE_LIBGTK3
	select BR2_PACKAGE_LIBGTK3_WAYLAND
	select BR2_PACKAGE_LIBGTK3_X11
	select BR2_PACKAGE_DBUS
	select BR2_PACKAGE_ALSA_LIB
	select BR2_PACKAGE_FONTCONFIG
	select BR2_PACKAGE_FREETYPE
	select BR2_PACKAGE_LIBXCB
	select BR2_PACKAGE_XLIB_LIBX11
	select BR2_PACKAGE_XLIB_LIBXCOMPOSITE
	select BR2_PACKAGE_XLIB_LIBXCURSOR
	select BR2_PACKAGE_XLIB_LIBXDAMAGE
	select BR2_PACKAGE_XLIB_LIBXEXT
	select BR2_PACKAGE_XLIB_LIBXFIXES
	select BR2_PACKAGE_XLIB_LIBXI
	select BR2_PACKAGE_XLIB_LIBXRANDR
	select BR2_PACKAGE_XLIB_LIBXRENDER
	help
	  Firefox ESR (official Mozilla binary, en-US) in /opt/firefox.
	  Runs natively on Wayland; the X11 libraries are only link dependencies.

	  https://www.mozilla.org/firefox/
```

## package/hexa-flatpak/Config.in
```kconfig
config BR2_PACKAGE_HEXA_FLATPAK
	bool "hexa-flatpak"
	depends on BR2_TOOLCHAIN_USES_GLIBC # libostree, sys/xattr.h
	depends on BR2_USE_WCHAR # libglib2
	depends on BR2_TOOLCHAIN_HAS_THREADS # libglib2
	depends on BR2_USE_MMU # bubblewrap, libglib2
	depends on BR2_PACKAGE_LIBGPG_ERROR_ARCH_SUPPORTS # libgpgme
	select BR2_PACKAGE_HEXA_APPSTREAM
	select BR2_PACKAGE_BUBBLEWRAP
	select BR2_PACKAGE_XDG_DBUS_PROXY
	select BR2_PACKAGE_HEXA_LIBOSTREE
	select BR2_PACKAGE_LIBGPGME
	select BR2_PACKAGE_LIBARCHIVE
	select BR2_PACKAGE_LIBCAP
	select BR2_PACKAGE_LIBCURL
	select BR2_PACKAGE_LIBFUSE3
	select BR2_PACKAGE_LIBGLIB2
	select BR2_PACKAGE_LIBSECCOMP
	select BR2_PACKAGE_LIBXML2
	select BR2_PACKAGE_JSON_GLIB
	select BR2_PACKAGE_GDK_PIXBUF
	select BR2_PACKAGE_ZSTD
	help
	  Flatpak: installs and runs sandboxed Linux apps from Flathub
	  (e.g. Steam). Each app brings its own libraries, including the
	  32-bit ones Steam needs.

	  Built without the system helper (polkit): install apps per user
	  (flatpak install --user), or as root for everyone.

	  https://flatpak.org
```

## package/hexa-libfyaml/Config.in
```kconfig
config BR2_PACKAGE_HEXA_LIBFYAML
	bool "hexa-libfyaml"
	depends on BR2_TOOLCHAIN_HAS_THREADS
	help
	  Fully featured YAML 1.2 parser library. Needed by AppStream
	  (and so by Flatpak).

	  https://github.com/pantoniou/libfyaml
```

## package/hexa-libostree/Config.in
```kconfig
config BR2_PACKAGE_HEXA_LIBOSTREE
	bool "hexa-libostree"
	depends on BR2_TOOLCHAIN_USES_GLIBC
	depends on BR2_USE_WCHAR # libglib2
	depends on BR2_TOOLCHAIN_HAS_THREADS # libglib2
	depends on BR2_USE_MMU # e2fsprogs, libglib2, libgpgme
	depends on BR2_PACKAGE_LIBGPG_ERROR_ARCH_SUPPORTS # libgpgme
	select BR2_PACKAGE_E2FSPROGS
	select BR2_PACKAGE_LIBCURL # downloads (HTTP)
	select BR2_PACKAGE_LIBGLIB2
	select BR2_PACKAGE_LIBGPG_ERROR
	select BR2_PACKAGE_LIBGPGME
	select BR2_PACKAGE_UTIL_LINUX
	select BR2_PACKAGE_UTIL_LINUX_LIBMOUNT
	select BR2_PACKAGE_XZ
	help
	  libostree (the storage of Flatpak) without composefs.

	  Buildroot's libostree package needs kernel headers 5.8 or
	  newer, only because of composefs (LOOP_CONFIGURE); the hexaOS
	  toolchain has 5.4 headers, and Flatpak does not use composefs.

	  https://ostreedev.github.io/ostree/
```

## package/hexa-max98390/Config.in
```kconfig
config BR2_PACKAGE_HEXA_MAX98390
	bool "hexa-max98390"
	depends on BR2_LINUX_KERNEL
	help
	  Driver for the four Maxim MAX98390 speaker amplifiers of the
	  Samsung Galaxy Book4 Pro/Ultra and Book5 laptops (the kernel
	  has none yet, so the speakers stay silent; headphones work).
	  Out-of-tree build of the driver from thesofproject/linux
	  PR #5616, as packaged by Andycodeman. /etc/init.d/S12speakers
	  creates the three amplifiers that ACPI does not declare.

	  https://github.com/Andycodeman/samsung-galaxy-book-linux-fixes

comment "hexa-max98390 needs a Linux kernel to be built"
	depends on !BR2_LINUX_KERNEL
```

## package/hexa-portal/Config.in
```kconfig
config BR2_PACKAGE_HEXA_PORTAL
	bool "hexa-portal"
	depends on BR2_PACKAGE_LIBGLIB2
	depends on BR2_PACKAGE_DBUS
	help
	  A small desktop portal (org.freedesktop.portal.Desktop) so
	  Flatpak apps can open links in the default browser and open
	  files and folders, and read the appearance settings. Started
	  by D-Bus on demand.
```

## package/hexa-power/Config.in
```kconfig
config BR2_PACKAGE_HEXA_POWER
	bool "hexa-power"
	depends on BR2_PACKAGE_LIBGTK3
	help
	  The hexaOS power window: shut down, restart, or restart the
	  desktop. Opened by hexa-power (Start menu > Power) on the
	  desktop; in text mode hexa-power shows a text menu instead.
```

## package/hexa-settings/Config.in
```kconfig
config BR2_PACKAGE_HEXA_SETTINGS
	bool "hexa-settings"
	depends on BR2_PACKAGE_LIBGTK3
	help
	  The hexaOS Settings app: Wi-Fi and wired network, sound,
	  display, wallpaper and taskbar, keyboard, mouse and touchpad,
	  date and time, power, account, background services and
	  information about the computer. System changes go through
	  /usr/libexec/hexa-settings-helper, run with sudo.
```

## package/hexa-sof-bin/Config.in
```kconfig
config BR2_PACKAGE_HEXA_SOF_BIN
	bool "hexa-sof-bin (Intel SOF audio firmware)"
	depends on BR2_x86_64
	help
	  Sound Open Firmware binaries and topologies for the audio DSP
	  of Intel Core Ultra (Meteor Lake) processors.
	  Installs only what "mtl" needs into /lib/firmware/intel.

	  https://github.com/thesofproject/sof-bin
```

## package/hexa-store/Config.in
```kconfig
config BR2_PACKAGE_HEXA_STORE
	bool "hexa-store"
	depends on BR2_PACKAGE_LIBGTK3
	depends on BR2_PACKAGE_HEXA_FLATPAK
	help
	  The hexaOS Store: finds, installs, updates and removes Flatpak
	  apps from Flathub and adds them to the Start menu.

	  Built from apps/com.hexaos.Store/src, the same source as the
	  Flatpak app, so it comes with the system (no GNOME runtime
	  needed). Outside the sandbox it runs flatpak directly.
```

## package/hexa-taskmgr/Config.in
```kconfig
config BR2_PACKAGE_HEXA_TASKMGR
	bool "hexa-taskmgr"
	depends on BR2_PACKAGE_LIBGTK3
	help
	  The hexaOS Task Manager: the open apps and the running programs
	  (grouped by name) with their CPU and memory use (end them from
	  here), live graphs of CPU, memory, disk and network use, and the
	  system services (start, stop, restart). Opens with Ctrl+Shift+Esc.
	  The Apps tab needs Weston patch 0008 (the shell's window list).
```

## package/hexa-vscode/Config.in
```kconfig
config BR2_PACKAGE_HEXA_VSCODE
	bool "hexa-vscode"
	depends on BR2_x86_64
	depends on BR2_TOOLCHAIN_USES_GLIBC
	depends on BR2_PACKAGE_XORG7
	depends on BR2_PACKAGE_MESA3D_GBM
	select BR2_PACKAGE_LIBGTK3
	select BR2_PACKAGE_LIBGTK3_WAYLAND
	select BR2_PACKAGE_LIBGTK3_X11
	select BR2_PACKAGE_AT_SPI2_CORE
	select BR2_PACKAGE_LIBNSS
	select BR2_PACKAGE_CUPS
	select BR2_PACKAGE_DBUS
	select BR2_PACKAGE_EXPAT
	select BR2_PACKAGE_ALSA_LIB
	select BR2_PACKAGE_LIBXKBCOMMON
	select BR2_PACKAGE_LIBXCB
	select BR2_PACKAGE_XLIB_LIBX11
	select BR2_PACKAGE_XLIB_LIBXCOMPOSITE
	select BR2_PACKAGE_XLIB_LIBXDAMAGE
	select BR2_PACKAGE_XLIB_LIBXEXT
	select BR2_PACKAGE_XLIB_LIBXFIXES
	select BR2_PACKAGE_XLIB_LIBXRANDR
	select BR2_PACKAGE_XLIB_LIBXKBFILE
	help
	  Visual Studio Code (official Microsoft binary) in /opt/vscode.
	  The "code" command starts it in native Wayland mode.

	  https://code.visualstudio.com/
```

## package/hexa-wine/Config.in
```kconfig
config BR2_PACKAGE_HEXA_WINE
	bool "hexa-wine (64-bit Wine with WoW64)"
	depends on BR2_x86_64
	depends on !BR2_STATIC_LIBS
	depends on BR2_TOOLCHAIN_HAS_THREADS_NPTL
	depends on BR2_PACKAGE_HAS_UDEV
	select BR2_PACKAGE_WAYLAND
	select BR2_PACKAGE_LIBXKBCOMMON
	select BR2_PACKAGE_LIBXML2 # libxkbregistry
	select BR2_PACKAGE_FREETYPE
	select BR2_PACKAGE_FONTCONFIG
	select BR2_PACKAGE_ALSA_LIB
	select BR2_PACKAGE_ALSA_LIB_SEQ
	select BR2_PACKAGE_ALSA_LIB_RAWMIDI
	select BR2_PACKAGE_GNUTLS
	select BR2_PACKAGE_PULSEAUDIO # libpulse (server: pipewire-pulse)
	select BR2_PACKAGE_VULKAN_LOADER
	depends on BR2_PACKAGE_MESA3D_OPENGL_EGL # OpenGL via EGL on Wayland
	help
	  Wine for x86_64 in the new WoW64 mode: runs 64 and 32-bit
	  Windows programs without 32-bit Linux libraries.
	  Uses Wine's Wayland driver (no X11 needed).

	  Requires the mingw compilers on the build machine:
	    sudo apt install gcc-mingw-w64

	  https://www.winehq.org
```
